#include "ir.h"
#include "rf433comm.h"
#include "tim.h"
#include "gpio.h"
//码库解码和 定时任务的
//#define tR_Buff  uc_gTimCmdArr 

/*发送已学习相关*/
volatile u8 	 uc_vgSendIRFlag;  //当此flag被置位 Tim3才会给红外发射管一个载波

u8 pwda[] = {0x94,0x9D,0x3C,0xAA,0x35,0x10,0x5B,0x5E,0x55,0x71,0x51,0x86,0x25,0x8A,0xD8,0xAC,0x98,0xB1,0xFE,0x05,\
             0xF2,0x82,0x2E,0x1C,0x7E,0x9F,0x40,0xDC,0x46,0xF7,0x7C,0x3D,0x7D,0x4D,0x45,0xD6,0xF5,0x49,0xD9,0x76,\
             0xE3,0xED,0x70,0xE6,0x00,0x23,0xB2,0x6C,0xA4,0xEF,0xA5,0x31,0xC4,0xC0,0xEC,0x5F,0x54,0xD1,0xCC,0xCD,\
             0xB7,0x64,0x12,0x0F,0x04,0xDB,0x27,0xBA,0xF6,0x1B,0xFD,0xB4,0x38,0xD0,0x02,0xDD,0xA0,0x11,0x18,0xC2,\
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             0xA9,0x2D,0x4E,0x68,0x52,0xD4,0xEB,0x6A,0xB0,0x84,0x78,0xDA,0x97,0x88,0x0D,0x91};

u8 pwdb[] = {0x27,0x33,0x8A,0x91,0x13,0xC4,0x46,0x6F,0xAD,0xAC,0xA8,0x4A,0x70,0xEB,0xB8,0xDC,0x8D,0x2E,0xBA,0x49,\
             0x02,0x2D,0x4E,0x79,0xD2,0xD3,0x99,0x8B,0xD4,0x7A,0x3C,0x18,0x20,0xCB,0x98,0x03,0x86,0xFC,0x84,0x72,\
             0x23,0x17,0x2A,0x12,0xBB,0xA1,0x1B,0xB9,0x34,0xE0,0xDF,0xE6,0x26,0xF1,0x66,0x3A,0x6C,0xC7,0xF5,0xF2,\
             0x0E,0x9E,0x5B,0x0D,0x71,0x83,0x21,0x57,0x52,0xCD,0x7C,0xA0,0x37,0x97,0xB6,0xBF,0x08,0xC3,0x53,0x07,\
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             0xFA,0x8F,0x41,0xEC,0x11,0x3E,0xDB,0xF6,0xDE,0xAB,0x6E,0x9F,0xB3,0xD1,0x89,0x51};

u8 pwdc[] = {0x56,0x16,0x91,0x69,0xB8,0x3F,0x8B,0x8A,0x06,0x87,0xC8,0xCF,0xF6,0xB5,0x1A,0xC5,0xFF,0x2F,0x6B,0x3A,\
             0xE5,0x6F,0x2B,0xD3,0xD9,0x3C,0x47,0x8E,0xF8,0x72,0xF0,0x6E,0x94,0xAF,0xA4,0x5F,0x03,0xD8,0xAB,0xCC,\
             0x85,0xF9,0xEC,0xEA,0x54,0x8C,0x07,0xB0,0x75,0x78,0x39,0x64,0x98,0x44,0x34,0x60,0xE8,0x76,0x14,0x52,\
             0x6D,0x4C,0x50,0x05,0x00,0x6A,0xDA,0xDC,0x61,0xF3,0x2E,0x6C,0xFB,0xD4,0x7B,0xAD,0x4E,0xC6,0x0F,0x71,\
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             0x89,0x92,0xFE,0x35,0x5E,0x15,0x57,0xE1,0xE4,0x67,0xDB,0xE6,0x02,0x13,0xA7,0xD6};

static int scnt;
static u8 tR_Buff[255]; //此保存解码后的数据
/**
  * @brief  DisCode_Ir  解码红外码库数据
  * @param 	p: 数据指针
	*	@param	len:数据长度
  * @retval None
  */
void DisCode_Ir(const u8 *p,u8 len)
{
	u8 K1,K2,K3,pv;
	u8 i;
//	uc_gTimCmdArr
	for(i=0;i<len;i++)
	{
	   tR_Buff[i]=*(p+i);
	}
	
	K1 = tR_Buff[0];
	K2 = len-1;
	
	tR_Buff[0]=K2;  //恢复长度
	
	for(K3=1;K3<len;K3++) 
  {
		pv=(pwda[K3]+pwdb[K2]-pwdc[K1]) % 256;
		tR_Buff[K3]=tR_Buff[K3]^pv;
  }
	
	if(tR_Buff[3])   //特殊编码跳变处理
	{
		scnt+=1;      //scnt为全局变量
		
		if(scnt % 2)	//决定是否跳变
		{
			if(tR_Buff[3]!=255)
			{
			  tR_Buff[tR_Buff[3]]=tR_Buff[tR_Buff[3]]^tR_Buff[4];
			}
			else	//处理PHILIPS跳变
			{
				K1=tR_Buff[26];
				K2=tR_Buff[27];
				K3=tR_Buff[28];
				tR_Buff[26]=tR_Buff[29];
				tR_Buff[27]=tR_Buff[30];
				tR_Buff[28]=tR_Buff[31];
				tR_Buff[29]=tR_Buff[32];
				tR_Buff[30]=K1;
				tR_Buff[31]=K2;
				tR_Buff[32]=K3;
			}  
		}	
	}
}				
/**
  * @brief  ExtractDataFormlib 从库中取出红外码库的码 取出来的时间应该是多少us
  * @param 	None
  * @retval None
  */
void SendIRFormlib(void)//装载码库数据并发送出去
{
	u8 cnt;
	u8 chr;
	static volatile u16 Bytet=0;
	static volatile u8 Bitt=0;
	u16 bytes = 0;

	u8 L_M_SB =0;
	u8 Code_Rule=0;
	u8 Order_Carrier_0 =0;
	u8 Order_Carrier_1 =0;
	u16  bits = 0;
	u16  i=0;
	ST_RFIRStudy IrStudyData;
	cnt = 15;
	chr= tR_Buff[cnt];
	IrStudyData.Data0HCnt = (((tR_Buff[7]&0x7F)<<8)+ tR_Buff[8]);
	IrStudyData.Data0HCnt /= 50;
	IrStudyData.Data0LCnt = (((tR_Buff[9]&0x7F)<<8)+ tR_Buff[10]);
	IrStudyData.Data0LCnt /= 50;
	IrStudyData.Data1HCnt = (((tR_Buff[11]&0x7F)<<8)+ tR_Buff[12]);
	IrStudyData.Data1HCnt /= 50;
	IrStudyData.Data1LCnt = (((tR_Buff[13]&0x7F)<<8)+ tR_Buff[14]);
	IrStudyData.Data1LCnt /= 50;
	L_M_SB = tR_Buff[5] & 0x0f;
	Code_Rule = tR_Buff[5]&0xf0;
	Order_Carrier_0 = tR_Buff[7] & (0x80);//逻辑0表示，1-先载波后间隔
	Order_Carrier_1 = tR_Buff[11] & (0x80);//逻辑1表示，1-先载波后间隔
	
	uc_vgTim2CountMode=DECREASE; //发送IR学习50us的定时器2为递减计数器
	__HAL_TIM_ENABLE(&htim3); //这里TIM3直接给载波
	__HAL_TIM_ENABLE(&htim2); //Tim2给脉冲长度50us时基
#if 1
	while ((chr != 0)) //执行红外发送
	{
		switch (chr)     //判断是什么类型
		{
			case 0xC1:     //载波时间
				us_vgPulseCnt = ((tR_Buff[cnt+1]<<8)+ tR_Buff[cnt+2]);
			  us_vgPulseCnt /= 50;
				uc_vgSendIRFlag=1;//载波使能
				while(us_vgPulseCnt>0){}
				IR_OUT(0);
				uc_vgSendIRFlag=0;//载波失能
				cnt += 3;    //后面跟2个字节 cnt跳到下一个标签（C1，C2或C3）					
				break;
			case 0xC2:     //间隔时间
				uc_vgSendIRFlag=0;//载波失能
			  IR_OUT(0);
				us_vgPulseCnt = ((tR_Buff[cnt+1]<<16)+(tR_Buff[cnt+2]<<8)+ tR_Buff[cnt+3]);
        us_vgPulseCnt /= 50;
				while(us_vgPulseCnt>0){}
				cnt += 4;    //后面跟3个字节 cnt跳到下一个标签（C1，C2或C3）
				break;
			case 0xC3:     //发送二进制序列
				{
    			bits = (tR_Buff[cnt + 1]<<8) + tR_Buff[cnt + 2];//要发送的bit数
    			for(i=0;i<bits;i++)
    			{
						if(0x00 == L_M_SB)//lsb
						{
							Bytet=i/8;  //字节数
							Bitt = i%8;
						}
						else          //msb
						{
							Bytet=i/8;
							Bitt= 7-(i%8);
						}
						
						if ((tR_Buff[cnt+3+Bytet] & 0x01<<Bitt)==0)//判断发逻辑0还是发逻辑1
						{
							if(0x80 == Order_Carrier_0)
							{
								uc_vgSendIRFlag=1;//载波使能
								us_vgPulseCnt=IrStudyData.Data0HCnt;
								while(us_vgPulseCnt>0){}
								IR_OUT(0);
								uc_vgSendIRFlag=0;//载波失能
								us_vgPulseCnt=IrStudyData.Data0LCnt;
								while(us_vgPulseCnt>0){}
							}
							else
							{
								IR_OUT(0);
								uc_vgSendIRFlag=0;//载波失能
								us_vgPulseCnt=IrStudyData.Data0HCnt;
								while(us_vgPulseCnt>0){}
								uc_vgSendIRFlag=1;//载波使能
								us_vgPulseCnt=IrStudyData.Data0LCnt;
								while(us_vgPulseCnt>0){}
							}
						}
						else //以下大括号发逻辑1
						{
							if(0x80 == Order_Carrier_1)
							{//先发载波再发间隔
								uc_vgSendIRFlag=1;//载波使能
								us_vgPulseCnt=IrStudyData.Data1HCnt;
								while(us_vgPulseCnt>0){}
								IR_OUT(0);
								uc_vgSendIRFlag=0;//载波失能
								us_vgPulseCnt=IrStudyData.Data1LCnt;
								while(us_vgPulseCnt>0){}
							}
							else
							{
								IR_OUT(0);
								uc_vgSendIRFlag=0;//载波失能
								us_vgPulseCnt=IrStudyData.Data1HCnt;
								while(us_vgPulseCnt>0){}
								uc_vgSendIRFlag=1;//载波使能
								us_vgPulseCnt=IrStudyData.Data1LCnt;
								while(us_vgPulseCnt>0){}
							}
						}
     		  }
					
					if(0 == Code_Rule)
					{
						uc_vgSendIRFlag=1;//载波使能
						us_vgPulseCnt=IrStudyData.Data1HCnt;
						while(us_vgPulseCnt>0){}
						uc_vgSendIRFlag=0;//载波失能
						IR_OUT(0);
          }
					bytes=bits/8;  //bits
					
					if((bits % 8) != 0)
				    	bytes = bytes + 1;   				     
					cnt = cnt + bytes + 3;    //改变cnt寻找下一个标签
				}
				break;
			default:
 				{
					tR_Buff[cnt]=0;//出错退出
 				}
 				break;				
		}
		chr = tR_Buff[cnt];
	}
	
	for(i =0;i<(tR_Buff[0]+1);i++)
	{
		tR_Buff[i] = 0x00;
	}
	__HAL_TIM_DISABLE(&htim2);  //关定时器2
	__HAL_TIM_DISABLE(&htim3);  //关定时器3
	uc_vgTim2CountMode=0;						//标记发送结束
	
	uc_vgSendIRFlag=0;            //不发送载波
	IR_OUT(0);
	#endif
}


/**
  * @brief  SendIRByte 字节层面的发送 供自定义学习的解码用
  * @param 	uc_argByte：需要发送的字节
  * @retval None
  */
static void SendIRByte(ST_RFIRStudy *stp_argIRStudy,u8 uc_argByte)
{
	u8 i;
	
	for(i=0;i<8;i++)
	{
		if(uc_argByte&0x80)
		{
			uc_vgSendIRFlag=1;
			us_vgPulseCnt=stp_argIRStudy->Data1HCnt;
			while(us_vgPulseCnt>0);
			
			uc_vgSendIRFlag=0;
			IR_OUT(0);
			us_vgPulseCnt=stp_argIRStudy->Data1LCnt;
			while(us_vgPulseCnt>0);
		}
		else
		{
			uc_vgSendIRFlag=1;
			us_vgPulseCnt=stp_argIRStudy->Data0HCnt;
			while(us_vgPulseCnt>0);
			
			uc_vgSendIRFlag=0;
			IR_OUT(0);
			us_vgPulseCnt=stp_argIRStudy->Data0LCnt;
			while(us_vgPulseCnt>0);
		}
		uc_argByte = uc_argByte << 1;
	}
}
/**
  * @brief  IRSendStudy 发送已学习过的红外数据 非码库
  * @param 	stp_argIRStudy:stp_argIRStudy
  * @retval None
  */
void IRSendStudy(ST_RFIRStudy *stp_argIRStudy)
{
	u8 i;
	uc_vgTim2CountMode=DECREASE; //发送IR学习50us的定时器2为递减计数器
	/*头码高*/
	uc_vgSendIRFlag=1;
	us_vgPulseCnt=stp_argIRStudy->HeadHCnt;
	__HAL_TIM_ENABLE(&htim3); //这里TIM3直接给载波
	__HAL_TIM_ENABLE(&htim2); //脉冲长度时基
	while(us_vgPulseCnt>0);
	/*头码低*/
	uc_vgSendIRFlag=0;  
	IR_OUT(0);
	us_vgPulseCnt=stp_argIRStudy->HeadLCnt;
	while(us_vgPulseCnt>0);
	
	for(i=0; i< stp_argIRStudy->Len; i++){
		SendIRByte(stp_argIRStudy,stp_argIRStudy->Data[i]);
	}
	__HAL_TIM_DISABLE(&htim2);  //关定时器2
	__HAL_TIM_DISABLE(&htim3);  //关定时器3
	uc_vgTim2CountMode=0;						//标记发送结束
	
	
	uc_vgSendIRFlag=0;            //不发送载波
	IR_OUT(0);
}
